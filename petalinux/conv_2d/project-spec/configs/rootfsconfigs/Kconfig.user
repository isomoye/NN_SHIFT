## petalinux/conv_2d/project-spec/configs/rootfsconfigs/Kconfig.user
```kconfig
menu "user packages " 
config gpio-demo  
	 bool "gpio-demo"
	 help
	
config peekpoke  
	 bool "peekpoke"
	 help
	
config xvc-driver  
	 bool "xvc-driver"
	 help
	
config xvcServer  
	 bool "xvcServer"
	 help
	
endmenu
```

## petalinux/test_bin/project-spec/configs/rootfsconfigs/Kconfig.user
```kconfig
menu "user packages " 
config gpio-demo  
	 bool "gpio-demo"
	 help
	
config peekpoke  
	 bool "peekpoke"
	 help
	
config xvcServer  
	 bool "xvcServer"
	 help
	
endmenu
```
